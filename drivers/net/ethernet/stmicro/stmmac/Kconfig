## drivers/net/ethernet/stmicro/stmmac/Kconfig
```kconfig
config STMMAC_ETH
	tristate "STMicroelectronics 10/100/1000 Ethernet driver"
	depends on HAS_IOMEM
	select NET_CORE
	select MII
	select PHYLIB
	select CRC32
	---help---
	  This is the driver for the Ethernet IPs are built around a
	  Synopsys IP Core and only tested on the STMicroelectronics
	  platforms.

if STMMAC_ETH

config LS1X_GMAC0
	bool "Loongson1 GMAC0 support"
	default y
	depends on LS1A_MACH || LS1B_MACH || LS1C_MACH

choice
		prompt "ls1x gmac0 config"
		depends on LS1X_GMAC0

config LS1X_GMAC0_100M
		bool "100Mb MII mode"

config LS1X_GMAC0_1000M
		bool "1000Mb MII mode"

config LS1X_GMAC0_RMII
		bool "100Mb RMII mode"
		depends on LS1C_MACH
endchoice

config LS1X_GMAC1
	bool "Loongson1 GMAC1 support"
	default n
	depends on LS1A_MACH || LS1B_MACH

choice
		prompt "ls1x gmac1 config"
		depends on LS1X_GMAC1

config LS1X_GMAC1_100M
		bool "100Mb MII mode"

config LS1X_GMAC1_1000M
		bool "1000Mb MII mode"
endchoice

config STMMAC_DEBUG_FS
	bool "Enable monitoring via sysFS "
	default n
	depends on STMMAC_ETH && DEBUG_FS
	-- help
	  The stmmac entry in /sys reports DMA TX/RX rings
	  or (if supported) the HW cap register.

config STMMAC_DA
	bool "STMMAC DMA arbitration scheme"
	default n
	---help---
	  Selecting this option, rx has priority over Tx (only for Giga
	  Ethernet device).
	  By default, the DMA arbitration scheme is based on Round-robin
	  (rx:tx priority is 1:1).

config STMMAC_TIMER
	bool "STMMAC Timer optimisation"
	default n
	depends on RTC_HCTOSYS_DEVICE
	---help---
	  Use an external timer for mitigating the number of network
	  interrupts. Currently, for SH architectures, it is possible
	  to use the TMU channel 2 and the SH-RTC device.

choice
        prompt "Select Timer device"
        depends on STMMAC_TIMER

config STMMAC_TMU_TIMER
        bool "TMU channel 2"
        depends on CPU_SH4
	---help---

config STMMAC_RTC_TIMER
        bool "Real time clock"
        depends on RTC_CLASS
	---help---

endchoice

choice
	prompt "Select the DMA TX/RX descriptor operating modes"
	depends on STMMAC_ETH
	---help---
	  This driver supports DMA descriptor to operate both in dual buffer
	  (RING) and linked-list(CHAINED) mode. In RING mode each descriptor
	  points to two data buffer pointers whereas in CHAINED mode they
	  points to only one data buffer pointer.

config STMMAC_RING
	bool "Enable Descriptor Ring Mode"

config STMMAC_CHAINED
	bool "Enable Descriptor Chained Mode"

endchoice


endif
```
